## zephyr/Kconfig
```kconfig
# Punto de entrada del Kconfig. 
if SENSOR
rsource "drivers/sensor/Kconfig"
endif # SENSOR
```

## zephyr/dts/bindings/sensor/adafruit,si7021.yaml
```yaml
description: "Silicon Labs Si7021 humidity and temperature sensor (Adafruit breakout)"
compatible: "adafruit,si7021"
include: [sensor-device.yaml, i2c-device.yaml]
```
